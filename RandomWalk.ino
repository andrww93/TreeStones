#include <Wire.h>
#include <Adafruit_GFX.h>
#include "Adafruit_LEDBackpack.h"


Adafruit_BicolorMatrix matrix = Adafruit_BicolorMatrix();

int speed;
int xPos;
int yPos;
int xDir;
int yDir;


void setup() {
  // put your setup code here, to run once:
  Serial.begin(9600);
  matrix.begin(0x70);
  
  speed=100;
   

  xPos=int(random(12,40));
  yPos=int(random(12,40));
  
  xDir=-1;
  yDir=-1;



}


  int counter; //will count loops for generating new x/y directions

// 'RBIT64', 64x64px
const unsigned char img [] PROGMEM = {
  0x9f, 0x86, 0xe0, 0x85, 0x6a, 0x43, 0x57, 0x83, 0x54, 0x5d, 0x97, 0xaa, 0x86, 0xb9, 0x59, 0x5c, 
  0x29, 0xac, 0x27, 0x98, 0x3b, 0x65, 0xf1, 0xf9, 0xb7, 0x17, 0x38, 0x8c, 0xcc, 0x1b, 0x02, 0xfd, 
  0x67, 0xdf, 0x47, 0x05, 0x8f, 0x13, 0x6c, 0x23, 0x9b, 0xfc, 0xb7, 0x4c, 0xa5, 0x23, 0x95, 0x45, 
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  0xab, 0x7b, 0xe1, 0xcb, 0xca, 0x6a, 0xfd, 0x70, 0x2d, 0x4c, 0x94, 0x48, 0xf1, 0x28, 0x13, 0xd9
};
void loop() {
  
  // put your main code here, to run repeatedly:
  //matrix.clear();
  matrix.drawBitmap(xPos,yPos,img, 64, 64, LED_RED);
  matrix.writeDisplay();

  if(xDir==1)
    xPos=xPos+1;
  if(xDir==-1)
    xPos=xPos-1;

  if(yDir==1)
    yPos=yPos+1;
  if(yDir==-1)
    yPos=yPos-1;

  counter++;
  //roll dice on new directions every 10 loops
  if(counter>6){
    //Serial.println("Counter Swap");
    xDir=int(random(-1,1));
    yDir=int(random(-1,1));
    counter=0;
  }

  if(xPos<-63)
    xPos=int(random(0,25));

  if(yPos<-63)
    yPos=int(random(0,25));

  delay(speed);
  matrix.clear();
  
  
}
